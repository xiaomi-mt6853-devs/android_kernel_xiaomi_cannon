## drivers/input/fingerprint/Kconfig
```kconfig
#
#Fingerprint
#
menu "Fingerprint support"
	depends on INPUT

config MTK_FINGERPRINT_SUPPORT
	bool "Mediatek Fingerprint"
	default n
	help
	  Fingerprint mtk driver enable/disable
	  in the kernel.Say Y here if you want to
	  use mediatek fingerprint driver,fingerprint
	  driver will support fingerprint function

config MTK_FINGERPRINT_SELECT
	string "sensor type"
	default "NA"

config GOODIX_CAP_FINGERPRINT
	bool "Goodix CAP Fingerprint"
	default y
	help
	  Goodix Fingerprint chip GF316M/GF318M/
	  GF3118M/GF518M/GF5118M/GF516M/GF816M/
	  GF3208/GF3206/GF3266/GF3288/GF5206/
	  GF5216/GF5208 TEE driver

config FPC_FINGERPRINT
    bool "fpc"
    depends on INPUT
    ---help---
      Say Y here if you want to enable fpc

endmenu
```

## drivers/input/touchscreen/NT36672C/Kconfig
```kconfig
#
# Touchscreen driver configuration
#

config TOUCH_FW_MP_ONE
	bool "TOUCH_FW_MP_ONE to determine novatek fw bin"
	help
	  To determine the novatek_firmware bin corresponding
	  to lcm_name.
```

## drivers/input/touchscreen/xiaomi-spi-tp/Kconfig
```kconfig
config XIAOMI_SPI_TOUCH
	bool
	default y if TOUCHSCREEN_NT36xxx_HOSTDL_SPI=y
	help
	  Say Y if want use xiaomi touch panel.
```
